## main/Kconfig.projbuild
```kconfig
menu "Project Settings"

config WIFI_SSID
    string "WiFi SSID"
	default "Wireless PKU"
	help
		SSID (network name) for the example to connect to.

config WIFI_PASSWORD
    string "WiFi Password"
	default ""
	help
		WiFi password (WPA or WPA2) for the example to use.

		Can be left blank if the network has no security set.

endmenu
```
